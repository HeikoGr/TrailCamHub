## main/Kconfig.projbuild
```kconfig
menu "TrailCamHub PoC"

config CAMERA_WIFI_ENABLE_PAYLOAD_HEX
    string "Wi-Fi enable payload (hex)"
    default "42545F4B45595F4F4E"
    help
        Payload to write to characteristic 0x0002, separated by optional spaces,
        colons, or hyphens. The default is ASCII "BT_KEY_ON".

config CAMERA_BLE_RELEASE_AFTER_ACTIVATION
    bool "Release BLE after the camera Wi-Fi was activated"
    default y
    help
        Disconnect from the camera and shut down the NimBLE stack and the
        Bluetooth controller once the camera has returned its Wi-Fi
        credentials. This returns their memory for the camera session; BLE
        is started again for the next activation. Disable this if the
        camera turns off its access point when the BLE connection ends.

config CAMERA_UDP_LOG_PACKET_HEX
    bool "Log camera UDP packet contents as hex"
    default y
    help
        Compile the per-packet hex dump of every camera UDP packet that is
        sent or received, in addition to the one-line packet summary. Useful
        while investigating the camera protocol. Both the hex dump and the
        one-line summaries use the DEBUG level, so they stay off in a normal
        INFO build (and out of the bulk-transfer hot path); raise the
        "trailcamhub_udp" tag to DEBUG to see them. Disable this option to
        drop the hex dump from the build entirely.

config DIAG_MEMORY_LOG_INTERVAL_S
    int "Memory log interval (seconds)"
    range 0 3600
    default 30
    help
        Log free and minimum free heap for internal RAM and PSRAM at this
        interval. Set to 0 to log memory only at fixed workflow stages.

menu "Session"

config SESSION_BLE_ACTIVATION_TIMEOUT_S
    int "Camera BLE activation timeout (seconds)"
    range 10 600
    default 90
    help
        Time allowed for finding the camera over BLE and receiving its Wi-Fi
        credentials after a scan was requested. A timeout counts as a failed
        attempt.

config SESSION_WIFI_JOIN_TIMEOUT_S
    int "Wi-Fi join timeout (seconds)"
    range 5 300
    default 30
    help
        Time allowed for joining the camera access point after the camera
        returned its Wi-Fi credentials, and for joining the home Wi-Fi for
        the backend uplink.

config SESSION_MAX_ATTEMPTS
    int "Camera attempts per scan"
    range 1 10
    default 3
    help
        A scan activates the camera at most this many times before giving
        up. The hub then returns to idle and waits for the next request; it
        does not retry on its own.

config SESSION_RETRY_DELAY_S
    int "Delay between camera attempts (seconds)"
    range 1 600
    default 10

config SESSION_AUTO_SCAN_INTERVAL_MIN
    int "Automatic scan interval (minutes, 0 = off)"
    range 0 1440
    default 0
    help
        Start a scan at this interval in addition to requests over the
        serial console. 0 disables automatic scans: the hub only scans when
        asked (for example from the web installer).

config SESSION_SCAN_ON_BOOT
    bool "Scan once after boot"
    default n
    help
        Start one scan right after the hub has booted.

endmenu

menu "SD card"

config SD_CARD_ENABLE
    bool "Mount the SD card at boot"
    default y
    help
        Mount the FAT file system of the microSD card at /sdcard using the
        SDMMC peripheral or, in SPI mode, an SPI bus. The card is never
        formatted automatically. On the ESP32-S3 boards the card is used in
        1-bit SDMMC mode on the GPIOs below; on the ESP32-P4-NANO it uses
        SDMMC slot 0 in 4-bit mode on its fixed IO MUX pins (CLK GPIO43, CMD
        GPIO44, D0-D3 GPIO39-42), powered by on-chip LDO channel 4. In SPI
        mode CLK is the SPI clock, CMD the MOSI and D0 the MISO line.

config SD_CARD_SPI_MODE
    bool "Use the card in SPI mode" if SOC_SDMMC_HOST_SUPPORTED
    depends on SD_CARD_ENABLE && !IDF_TARGET_ESP32P4
    default y if !SOC_SDMMC_HOST_SUPPORTED
    help
        Talk to the card over SPI2 instead of SDMMC. Required on chips
        without an SDMMC host (ESP32-C5). The bus may be shared with other
        devices such as a display.

config SD_CARD_CLK_GPIO
    int "CLK GPIO"
    depends on SD_CARD_ENABLE && !IDF_TARGET_ESP32P4
    range 0 48
    default 5

config SD_CARD_CMD_GPIO
    int "CMD GPIO"
    depends on SD_CARD_ENABLE && !IDF_TARGET_ESP32P4
    range 0 48
    default 4

config SD_CARD_D0_GPIO
    int "D0 GPIO"
    depends on SD_CARD_ENABLE && !IDF_TARGET_ESP32P4
    range 0 48
    default 6

config SD_CARD_CS_GPIO
    int "CS GPIO"
    depends on SD_CARD_SPI_MODE
    range 0 48
    default 23

config SD_CARD_LDO_CHANNEL
    int "On-chip LDO channel powering the card"
    depends on SD_CARD_ENABLE && IDF_TARGET_ESP32P4
    range 1 4
    default 4

endmenu

menu "Log on the SD card"
    depends on SD_CARD_ENABLE

config SD_LOG_ENABLE
    bool "Write the log to the SD card"
    default y
    help
        Copy every log line to /sdcard/logs/log-NNNNN.txt, so that a test
        run can be read afterwards (or live in the web UI) without a serial
        console. The lines are written about once per second and synced to
        the card. A new file is started at every boot and when a file
        reaches the size limit; the oldest files are removed.

config SD_LOG_MAX_FILE_KB
    int "Maximum size of one log file (KB)"
    depends on SD_LOG_ENABLE
    range 64 65536
    default 4096

config SD_LOG_MAX_FILES
    int "Log files to keep"
    depends on SD_LOG_ENABLE
    range 2 1000
    default 50

config SD_LOG_BUFFER_KB
    int "Log buffer in PSRAM (KB)"
    depends on SD_LOG_ENABLE
    range 8 1024
    default 64
    help
        Holds the lines until they are written, including the boot messages
        before the card is mounted. Without PSRAM an 8 KB buffer in internal
        RAM is used.

endmenu


endmenu
```
